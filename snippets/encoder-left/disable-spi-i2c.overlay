// Disable SPI0/I2C0 on left peripheral to free GPIO0.18/16 for encoder
// This is needed for left-only encoder configuration without trackball/trackpad

&spi0 {
    status = "disabled";
};

&i2c0 {
    status = "disabled";
};
