#include "torabo_tsuki_lp.dtsi"
#include <input/processors.dtsi>
#include <input/processors/runtime-input-processor.dtsi>
#include <dt-bindings/zmk/input_transform.h>
#include <dt-bindings/zmk/runtime_input_processor.h>
#include <zephyr/dt-bindings/input/input-event-codes.h>

/*
 * 左をセントラルにするビルド用。標準構成では左はペリフェラルなので
 * pointing_listener は disabled のままで、この設定は効かない。
 * 右と同じ構成にしておき、左右を入れ替えても挙動が変わらないようにする。
 */
&pointing_listener {
    input-processors = <&zip_xy_transform (INPUT_TRANSFORM_X_INVERT | INPUT_TRANSFORM_Y_INVERT)>,
                       <&mouse_runtime_input_processor>,
                       <&scroll_runtime_input_processor>;
};

&mouse_runtime_input_processor {
    scale-multiplier = <2>;
    scale-divisor = <3>;
};

&scroll_runtime_input_processor {
    /* 有効レイヤーは LT_SCR (keymap.keymap のスクロールレイヤー = 5) */
    active-layers = <(1 << 5)>;

    x-codes = <INPUT_REL_X>;
    y-codes = <INPUT_REL_Y>;
    xy-to-scroll-enabled;

    axis-snap-mode = <AXIS_SNAP_MODE_Y>;
    axis-snap-threshold = <600>;
};
