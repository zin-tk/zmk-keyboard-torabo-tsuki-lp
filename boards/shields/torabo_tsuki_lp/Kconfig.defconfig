## boards/shields/torabo_tsuki_lp/Kconfig.defconfig
```kconfig
if SHIELD_TORABO_TSUKI_LP_LEFT || SHIELD_TORABO_TSUKI_LP_RIGHT

config ZMK_KEYBOARD_NAME
    default "torabo-tsuki"

config ZMK_SPLIT
    default y

config SPI
    default y

config INPUT
    default y

config ZMK_MOUSE
    default y

config ZMK_BATTERY_REPORTING
    default y

config ZMK_BATTERY_HISTORY
    bool
    default y

config ZMK_BATTERY_HISTORY_STUDIO_RPC
    bool
    default y

config NANOPB
    bool
    default y

config ZMK_SPLIT_RELAY_EVENT
    bool
    default y
 
endif
```
